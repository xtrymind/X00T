## drivers/input/fingerprint/Kconfig
```kconfig
#
# Fingerprint driver configuration
#

menuconfig INPUT_FINGERPRINT
	bool "Fingerprint"
	help
	  Say Y here, and a list of supported fingerprint will be displayed.
	  This option doesn't affect the kernel.

	  If unsure, say Y.

if INPUT_FINGERPRINT

config COMMON_FP
	bool "Fingerprint common"
	default n
	help
	  Say Y here if you use common fp.
	  If unsure, say N.

config CDFINGER_FP
	bool "Fingerprint cdfinger"
	help
	  Say Y here if you use cdfinger fingerprint.
	  If unsure, say N.

config GOODIX_FP
	bool "Fingerprint goodix"
	select COMMON_FP
	help
	  Say Y here if you use goodix fingerprint.
	  If unsure, say N.

endif
```

## drivers/input/touchscreen/NVT_Touch/Kconfig
```kconfig
#
# Novatek NT36xxx touchscreen driver configuration
#
config TOUCHSCREEN_NT36xxx
	bool "Novatek NT36xxx"
	default y
	help
	  Say Y here if you have a Novatek NT36xxx touchscreen connected
	  to your system.

	  If unsure, say N.

if TOUCHSCREEN_NT36xxx

config TOUCHSCREEN_NT36xxx_EXT_PROC
	bool "Novatek NT36xxx EXT PROC"
	help
	  Say Y here to disable NT36xxx EXT PROC

config TOUCHSCREEN_NT36xxx_MP
	bool "Novatek NT36xxx MP"
	help
	  Say Y here to disable NT36xxx MP

endif
```
